/**
 * @cliArgs --board "/ti/boards/CC3220SF_LAUNCHXL" --product "simplelink_cc32xx_sdk@4_20_00_07"
 * @versions {"data":"2021010520","timestamp":"2021010520","tool":"1.7.0+1746","templates":null}
 */
const bp_BPBASSENSORSMKII = scripting.addHardware("/ti/boards/boosterpacks/BP-BASSENSORSMKII");

/**
 * Import the modules used in this configuration.
 */
const ADC    = scripting.addModule("/ti/drivers/ADC", {}, false);
const ADC1   = ADC.addInstance();
const GPIO   = scripting.addModule("/ti/drivers/GPIO");
const GPIO1  = GPIO.addInstance();
const GPIO2  = GPIO.addInstance();
const GPIO3  = GPIO.addInstance();
const GPIO4  = GPIO.addInstance();
const GPIO5  = GPIO.addInstance();
const GPIO6  = GPIO.addInstance();
const GPIO7  = GPIO.addInstance();
const GPIO8  = GPIO.addInstance();
const GPIO9  = GPIO.addInstance();
const I2C    = scripting.addModule("/ti/drivers/I2C");
const I2C1   = I2C.addInstance();
const RTOS   = scripting.addModule("/ti/drivers/RTOS");
const Timer  = scripting.addModule("/ti/drivers/Timer", {}, false);
const Timer1 = Timer.addInstance();
const Timer2 = Timer.addInstance();
const UART   = scripting.addModule("/ti/drivers/UART", {}, false);
const UART1  = UART.addInstance();

/**
 * Write custom configuration values to the imported modules.
 */
ADC1.$name              = "CONFIG_ADC_0";
ADC1.$hardware          = bp_BPBASSENSORSMKII.components.DRV5055.subComponents.OUTPUT;
ADC1.adc.$assign        = "ADC0";
ADC1.adc.adcPin.$assign = "boosterpack.2";

GPIO1.$hardware = system.deviceData.board.components.LED_RED;
GPIO1.$name     = "CONFIG_GPIO_LED_0";

GPIO2.$name           = "CONFIG_GPIO_0";
GPIO2.mode            = "Output";
GPIO2.gpioPin.$assign = "boosterpack.4";

GPIO3.$name = "CONFIG_GPIO_1";
GPIO3.mode  = "Output";

GPIO4.$name = "CONFIG_GPIO_2";
GPIO4.mode  = "Output";

GPIO5.$name = "CONFIG_GPIO_3";
GPIO5.mode  = "Output";

GPIO6.$name = "CONFIG_GPIO_4";
GPIO6.mode  = "Output";

GPIO7.$name = "CONFIG_GPIO_5";
GPIO7.mode  = "Output";

GPIO8.$name = "CONFIG_GPIO_6";
GPIO8.mode  = "Output";

GPIO9.$name = "CONFIG_GPIO_7";
GPIO9.mode  = "Output";

I2C1.$name     = "CONFIG_I2C_TMP";
I2C1.$hardware = system.deviceData.board.components.LP_I2C;

const Power          = scripting.addModule("/ti/drivers/Power", {}, false);
Power.parkPins.$name = "ti_drivers_power_PowerCC32XXPins0";

RTOS.name = "FreeRTOS";

Timer1.$name         = "CONFIG_TIMER_0";
Timer1.timerType     = "32 Bits";
Timer1.timer.$assign = "Timer0";

Timer2.$name         = "CONFIG_TIMER_1";
Timer2.timerType     = "32 Bits";
Timer2.timer.$assign = "Timer1";

UART1.$name              = "CONFIG_UART_0";
UART1.dataDirection      = "Send Only";
UART1.uart.txPin.$assign = "boosterpack.28";
scripting.suppress("Connected to hardware,@@@.+?@@@ is connected to TMP117 Power on the CC3220SF LaunchPad\. Consider selecting it in 'use hardware' above\. @@@.+?@@@",UART1.uart.txPin);

/**
 * Pinmux solution for unlocked pins/peripherals. This ensures that minor changes to the automatic solver in a future
 * version of the tool will not impact the pinmux you originally saw.  These lines can be completely deleted in order to
 * re-solve from scratch.
 */
GPIO1.gpioPin.$suggestSolution   = "boosterpack.29";
GPIO3.gpioPin.$suggestSolution   = "boosterpack.7";
GPIO4.gpioPin.$suggestSolution   = "boosterpack.14";
GPIO5.gpioPin.$suggestSolution   = "boosterpack.15";
GPIO6.gpioPin.$suggestSolution   = "boosterpack.18";
GPIO7.gpioPin.$suggestSolution   = "boosterpack.19";
GPIO8.gpioPin.$suggestSolution   = "boosterpack.17";
GPIO9.gpioPin.$suggestSolution   = "boosterpack.30";
I2C1.i2c.$suggestSolution        = "I2C0";
I2C1.i2c.sdaPin.$suggestSolution = "boosterpack.10";
I2C1.i2c.sclPin.$suggestSolution = "boosterpack.9";
UART1.uart.$suggestSolution      = "UART0";
