/**
 * These arguments were used when this file was generated. They will be automatically applied on subsequent loads
 * via the GUI or CLI. Run CLI with '--help' for additional information on how to override these arguments.
 * @cliArgs --board "/ti/boards/CC3220SF_LAUNCHXL" --product "simplelink_cc32xx_sdk@4_20_00_07"
 * @versions {"data":"2021010520","timestamp":"2021010520","tool":"1.7.0+1746","templates":null}
 */

/**
 * Import the modules used in this configuration.
 */
const DriverLib      = scripting.addModule("/ti/devices/DriverLib");
const Display        = scripting.addModule("/ti/display/Display", {}, false);
const Display1       = Display.addInstance();
const Board          = scripting.addModule("/ti/drivers/Board");
const Crypto         = scripting.addModule("/ti/drivers/Crypto");
const Crypto1        = Crypto.addInstance();
const DMA            = scripting.addModule("/ti/drivers/DMA");
const GPIO           = scripting.addModule("/ti/drivers/GPIO");
const GPIO1          = GPIO.addInstance();
const GPIO2          = GPIO.addInstance();
const GPIO3          = GPIO.addInstance();
const I2C            = scripting.addModule("/ti/drivers/I2C", {}, false);
const I2C1           = I2C.addInstance();
const Power          = scripting.addModule("/ti/drivers/Power");
const SPI            = scripting.addModule("/ti/drivers/SPI");
const SPI1           = SPI.addInstance();
const Timer          = scripting.addModule("/ti/drivers/Timer");
const Timer1         = Timer.addInstance();
const Timer2         = Timer.addInstance();
const Timer3         = Timer.addInstance();
const Timer4         = Timer.addInstance();
const UART           = scripting.addModule("/ti/drivers/UART", {}, false);
const UART1          = UART.addInstance();
const Watchdog       = scripting.addModule("/ti/drivers/Watchdog");
const Watchdog1      = Watchdog.addInstance();
const SimpleLinkWifi = scripting.addModule("/ti/drivers/net/wifi/SimpleLinkWifi");
const SlNet          = scripting.addModule("/ti/net/SlNet");
const SlNet1         = SlNet.addInstance();

/**
 * Write custom configuration values to the imported modules.
 */
Display1.$name                   = "CONFIG_Display_0";
Display1.$hardware               = system.deviceData.board.components.XDS110UART;
Display1.uart.$name              = "CONFIG_UART_1";
Display1.uart.uart.$assign       = "UART1";
Display1.uart.uart.txPin.$assign = "55";
Display1.uart.uart.rxPin.$assign = "57";

Crypto1.$name = "CONFIG_Crypto_0";

GPIO1.$hardware       = system.deviceData.board.components.SW3;
GPIO1.$name           = "CONFIG_GPIO_BUTTON_1";
GPIO1.gpioPin.$assign = "boosterpack.11";

GPIO2.$hardware      = system.deviceData.board.components.LED_RED;
GPIO2.outputStrength = "High";
GPIO2.$name          = "CONFIG_GPIO_LED_0";

GPIO3.$name           = "CONFIG_GPIO_MOTOCTL_8";
GPIO3.gpioPin.$assign = "boosterpack.4";

I2C1.$name              = "CONFIG_I2C_0";
I2C1.i2c.$assign        = "I2C0";
I2C1.i2c.sdaPin.$assign = "boosterpack.10";
I2C1.i2c.sclPin.$assign = "boosterpack.9";
scripting.suppress("Connected to hardware,@@@.+?@@@ is connected to LaunchPad I2C on the CC3220SF LaunchPad\. Consider selecting it in 'use hardware' above\. @@@.+?@@@",I2C1.i2c.sdaPin);
scripting.suppress("Connected to hardware,@@@.+?@@@ is connected to LaunchPad I2C on the CC3220SF LaunchPad\. Consider selecting it in 'use hardware' above\. @@@.+?@@@",I2C1.i2c.sclPin);

Power.ioRetentionShutdown = ["GRP_1"];
Power.parkPins.$name      = "ti_drivers_power_PowerCC32XXPins0";

SPI1.$name                    = "CONFIG_SPI_0";
SPI1.mode                     = "Four Pin SS Active Low";
SPI1.defaultTxBufferValue     = "0";
SPI1.spi.$assign              = "SPI0";
SPI1.spi.sclkPin.$assign      = "boosterpack.7";
SPI1.spi.misoPin.$assign      = "boosterpack.14";
SPI1.spi.mosiPin.$assign      = "boosterpack.15";
SPI1.spi.dmaRxChannel.$assign = "UDMA_CH6";
SPI1.spi.dmaTxChannel.$assign = "UDMA_CH7";
SPI1.spi.ssPin.$assign        = "boosterpack.18";

Timer1.$name         = "CONFIG_TIMER_0";
Timer1.timerType     = "32 Bits";
Timer1.timer.$assign = "Timer0";

Timer2.$name         = "CONFIG_TIMER_1";
Timer2.timerType     = "32 Bits";
Timer2.timer.$assign = "Timer1";

Timer3.$name         = "CONFIG_TIMER_2";
Timer3.timerType     = "32 Bits";
Timer3.timer.$assign = "Timer2";

Timer4.$name         = "CONFIG_TIMER_3";
Timer4.timerType     = "32 Bits";
Timer4.timer.$assign = "Timer3";

UART1.$name              = "CONFIG_UART_0";
UART1.uart.$assign       = "UART0";
UART1.uart.txPin.$assign = "boosterpack.8";
UART1.uart.rxPin.$assign = "boosterpack.3";
scripting.suppress("Connected to hardware,@@@.+?@@@ is connected to BMA222E Temperature Interrupt on the CC3220SF LaunchPad\. Consider selecting it in 'use hardware' above\. @@@.+?@@@",UART1.uart.rxPin);

Watchdog1.$name            = "CONFIG_WATCHDOG_0";
Watchdog1.watchdog.$assign = "WATCHDOG0";

SlNet1.$name  = "CONFIG_SLNET";
SlNet1.ifName = "CC32xx";

/**
 * Pinmux solution for unlocked pins/peripherals. This ensures that minor changes to the automatic solver in a future
 * version of the tool will not impact the pinmux you originally saw.  These lines can be completely deleted in order to
 * re-solve from scratch.
 */
GPIO2.gpioPin.$suggestSolution = "boosterpack.29";
