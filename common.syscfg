/**
 * These arguments were used when this file was generated. They will be automatically applied on subsequent loads
 * via the GUI or CLI. Run CLI with '--help' for additional information on how to override these arguments.
 * @cliArgs --board "/ti/boards/CC3220SF_LAUNCHXL" --product "simplelink_cc32xx_sdk@4_20_00_07"
 * @versions {"data":"2021010520","timestamp":"2021010520","tool":"1.7.0+1746","templates":null}
 */

/**
 * Import the modules used in this configuration.
 */
const DriverLib      = scripting.addModule("/ti/devices/DriverLib");
const Display        = scripting.addModule("/ti/display/Display");
const Display1       = Display.addInstance();
const ADC            = scripting.addModule("/ti/drivers/ADC", {}, false);
const ADC1           = ADC.addInstance();
const ADC2           = ADC.addInstance();
const Board          = scripting.addModule("/ti/drivers/Board");
const Crypto         = scripting.addModule("/ti/drivers/Crypto");
const Crypto1        = Crypto.addInstance();
const DMA            = scripting.addModule("/ti/drivers/DMA");
const GPIO           = scripting.addModule("/ti/drivers/GPIO");
const GPIO1          = GPIO.addInstance();
const GPIO2          = GPIO.addInstance();
const GPIO3          = GPIO.addInstance();
const GPIO4          = GPIO.addInstance();
const GPIO5          = GPIO.addInstance();
const GPIO6          = GPIO.addInstance();
const GPIO7          = GPIO.addInstance();
const GPIO8          = GPIO.addInstance();
const GPIO9          = GPIO.addInstance();
const GPIO10         = GPIO.addInstance();
const GPIO11         = GPIO.addInstance();
const GPIO12         = GPIO.addInstance();
const GPIO13         = GPIO.addInstance();
const Power          = scripting.addModule("/ti/drivers/Power");
const SPI            = scripting.addModule("/ti/drivers/SPI");
const Timer          = scripting.addModule("/ti/drivers/Timer");
const Timer1         = Timer.addInstance();
const Timer2         = Timer.addInstance();
const Timer3         = Timer.addInstance();
const Timer4         = Timer.addInstance();
const UART           = scripting.addModule("/ti/drivers/UART", {}, false);
const UART2          = UART.addInstance();
const Watchdog       = scripting.addModule("/ti/drivers/Watchdog");
const Watchdog1      = Watchdog.addInstance();
const SimpleLinkWifi = scripting.addModule("/ti/drivers/net/wifi/SimpleLinkWifi");
const SlNet          = scripting.addModule("/ti/net/SlNet");
const SlNet1         = SlNet.addInstance();

/**
 * Write custom configuration values to the imported modules.
 */
Display1.$name                          = "CONFIG_Display_0";
Display1.$hardware                      = system.deviceData.board.components.XDS110UART;
Display1.uart.$name                     = "CONFIG_UART_0";
Display1.uart.useDMA                    = true;
Display1.uart.uart.$assign              = "UART0";
Display1.uart.uart.txPin.$assign        = "55";
Display1.uart.uart.rxPin.$assign        = "57";
Display1.uart.uart.txDmaChannel.$assign = "UDMA_CH9";
Display1.uart.uart.rxDmaChannel.$assign = "UDMA_CH8";

ADC1.$name                     = "CONFIG_ADC_0";
ADC1.adc.$assignAllowConflicts = "ADC0";
ADC1.adc.adcPin.$assign        = "boosterpack.24";
scripting.suppress("Resource conflict,ADC0 is also in use by @@@.+?@@@",ADC1.adc);

ADC2.$name                     = "CONFIG_ADC_1";
ADC2.adc.$assignAllowConflicts = "ADC0";
ADC2.adc.adcPin.$assign        = "boosterpack.26";
scripting.suppress("Resource conflict,ADC0 is also in use by @@@.+?@@@",ADC2.adc);

Crypto1.$name = "CONFIG_Crypto_0";

GPIO1.$hardware       = system.deviceData.board.components.SW2;
GPIO1.$name           = "CONFIG_GPIO_BUTTON_0";
GPIO1.gpioPin.$assign = "boosterpack.3";

GPIO2.$hardware       = system.deviceData.board.components.SW3;
GPIO2.$name           = "CONFIG_GPIO_BUTTON_1";
GPIO2.gpioPin.$assign = "boosterpack.11";

GPIO3.$hardware      = system.deviceData.board.components.LED_RED;
GPIO3.outputStrength = "High";
GPIO3.$name          = "CONFIG_GPIO_LED_0";

GPIO4.$hardware      = system.deviceData.board.components.LED_YELLOW;
GPIO4.outputStrength = "High";
GPIO4.$name          = "CONFIG_GPIO_LED_1";

GPIO5.$hardware      = system.deviceData.board.components.LED_GREEN;
GPIO5.outputStrength = "High";
GPIO5.$name          = "CONFIG_GPIO_LED_2";

GPIO6.$name           = "CONFIG_GPIO_0";
GPIO6.mode            = "Dynamic";
GPIO6.gpioPin.$assign = "boosterpack.4";

GPIO7.$name           = "CONFIG_GPIO_1";
GPIO7.mode            = "Dynamic";
GPIO7.gpioPin.$assign = "boosterpack.13";

GPIO8.$name           = "CONFIG_GPIO_2";
GPIO8.mode            = "Dynamic";
GPIO8.gpioPin.$assign = "boosterpack.17";

GPIO9.$name           = "CONFIG_GPIO_3";
GPIO9.gpioPin.$assign = "boosterpack.30";

GPIO10.$name           = "CONFIG_GPIO_4";
GPIO10.gpioPin.$assign = "boosterpack.19";

GPIO11.$name = "CONFIG_GPIO_5";

GPIO12.$name = "CONFIG_GPIO_6";

GPIO13.$name = "CONFIG_GPIO_7";

Power.ioRetentionShutdown = ["GRP_1"];
Power.parkPins.$name      = "ti_drivers_power_PowerCC32XXPins0";

Timer1.$name         = "CONFIG_TIMER_0";
Timer1.timerType     = "32 Bits";
Timer1.timer.$assign = "Timer0";

Timer2.$name         = "CONFIG_TIMER_1";
Timer2.timerType     = "32 Bits";
Timer2.timer.$assign = "Timer1";

Timer3.$name         = "CONFIG_TIMER_2";
Timer3.timerType     = "32 Bits";
Timer3.timer.$assign = "Timer2";

Timer4.$name         = "CONFIG_TIMER_3";
Timer4.timerType     = "32 Bits";
Timer4.timer.$assign = "Timer3";

UART2.$name              = "CONFIG_UART_1";
UART2.uart.$assign       = "UART1";
UART2.uart.rxPin.$assign = "boosterpack.18";
UART2.uart.txPin.$assign = "boosterpack.15";

Watchdog1.$name            = "CONFIG_WATCHDOG_0";
Watchdog1.watchdog.$assign = "WATCHDOG0";

SlNet1.$name  = "CONFIG_SLNET";
SlNet1.ifName = "CC32xx";

/**
 * Pinmux solution for unlocked pins/peripherals. This ensures that minor changes to the automatic solver in a future
 * version of the tool will not impact the pinmux you originally saw.  These lines can be completely deleted in order to
 * re-solve from scratch.
 */
GPIO3.gpioPin.$suggestSolution  = "boosterpack.29";
GPIO4.gpioPin.$suggestSolution  = "boosterpack.9";
GPIO5.gpioPin.$suggestSolution  = "boosterpack.10";
GPIO11.gpioPin.$suggestSolution = "boosterpack.7";
GPIO12.gpioPin.$suggestSolution = "boosterpack.14";
GPIO13.gpioPin.$suggestSolution = "boosterpack.28";
